## config/west.yml
```yaml
manifest:
  remotes:
    - name: zmkfirmware
      url-base: https://github.com/zmkfirmware
      # Additional modules containing boards/shields/custom code can be listed here as well.
      # See:
      # - https://zmk.dev/docs/features/modules
      # - https://docs.zephyrproject.org/3.5.0/develop/west/manifest.html#projects
    - name: urob
      url-base: https://github.com/urob
    - name: joelspadin
      url-base: https://github.com/joelspadin
  projects:
    - name: zmk
      remote: zmkfirmware
      revision: main
      import: app/west.yml
    - name: zmk-locales
      remote: joelspadin
      revision: main
    - name: zmk-unicode
      remote: urob
      revision: main
  self:
    path: boards
```
